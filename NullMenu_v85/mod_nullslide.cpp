// NullSlide  -  NullMenu 用モジュール(元のスケッチ NullSlide_v7 を名前空間に入れたもの)
// 0 で始まる変数(配列も)は、ほかの作品と共通の置き場(NM_ARENA)に置いています。
// 一度に動くのは1つだけ(切り替えるときは再起動)なので、重なっていても問題ありません。
#include "nm_common.h"
#if defined(ESP_PLATFORM) && __has_include(<lgfx/v1/panel/Panel_AMOLED.hpp>)
#include <lgfx/v1/panel/Panel_AMOLED.hpp>
#endif
#include <FFat.h>
#if defined(ESP_PLATFORM) || defined(NL_WIFI_TEST)
#include <WiFi.h>
#endif
#if defined(ESP_PLATFORM) || defined(NL_WIFI_TEST)
#include <WebServer.h>
#endif
#pragma GCC optimize("O3")

namespace NullSlide {
static constexpr size_t nmOv0 = 0;

// NullSlide v7  -  丸い画面で写真のスライドショー。写真は本体の Wi-Fi か USB ケーブルで送る
//   M5Stack StopWatch 用(丸い 466x466 画面)。CoreS3 系でも動きます(書き込むときに FATFS のある Partition Scheme を選ぶ)。
//
// 画面の中:
//   ・本体にしまってある写真(JPEG)を、決めた時間ごとに切り替えて見せます
//   ・切り替え方(パッと / ふわっとフェード / 横にスライド / ハートになって消える)、1枚の時間、順番(送った順 / ランダム)、
//     形(そのまま / ハート)、ハートの色(ハートのまわりと、切り替えのハートのふち)、向き、明るさを選べます。本体のボタンでも、送るページ(docs/slide.html)からでも変えられます
//   ・写真を切り替えたとき、下に「何枚目か」が少しのあいだ出ます
//
// 操作:
//   StopWatch … ボタンA 短押し: 次の写真   ボタンA 長押し: 前の写真   ボタンB 短押し: 設定
//               設定の中: ボタンA 短押し: 次の項目   ボタンB 短押し: 変える   ボタンA 長押し: とじる
//               「この写真を消す」: ボタンB: 消す   ボタンA: やめる
//               Wi-Fi の画面: ボタンA: QR コードを切り替え   ボタンB: Wi-Fi を切って戻る
//   CoreS3系  … 画面の右半分をタップ: 次の写真   左半分: 前の写真   電源ボタン短押し: 設定
//               設定の中: 項目をタップ: 変える   電源ボタン短押し・「とじる」: とじる
//               「この写真を消す」: 右半分をタップ: 消す   左半分・電源ボタン: やめる
//               Wi-Fi の画面: タップ: QR コードを切り替え   電源ボタン: Wi-Fi を切って戻る
//
// 写真の送り方(Wi-Fi):
//   1. ボタン B で設定を開いて「Wi-Fi で受け取る」を選ぶ(CoreS3 は電源ボタンで設定を開いて、タップ)
//   2. 画面の QR コードをスマホのカメラで読む → 本体の Wi-Fi「Null2-xxxx」に入る(パスワードは画面に出ている8けた)
//   3. A を押すと、ページの QR コードに変わる → 読む(または http://192.168.4.1 を開く)→ 写真を選ぶ
//   Wi-Fi に入ると、スマホは「インターネットなし」と出ますが、そのままで大丈夫です。ページが開かないときは、
//   スマホのモバイルデータ通信をいったん切ってみてください。終わったら B(CoreS3 は電源ボタン)で Wi-Fi を切ります。
//
// 写真の送り方(USB):
//   1. この作品を動かしたまま、USB ケーブルで PC につなぐ
//   2. PC の Chrome か Edge で「写真を送るページ」を開く
//      (GitHub の …/docs/slide.html。zip の中の docs/slide.html をダブルクリックで開いても使えます)
//   3. 「本体につなぐ」→ 出てきた一覧から StopWatch を選ぶ → 写真をページに落とす
//   ページが写真を画面の大きさに縮めて(「画面いっぱい」か「全体を入れる」を選べます)、JPEG にしてから送ります。
//   1枚 30〜80KB くらいなので、数百枚入ります(容量は GIF と共用)。いらない写真はページから消せます。
//   (Arduino IDE のシリアルモニタを開いていると、ページからつなげません。閉じてからつないでください)
//
// しまう場所:
//   書き込むときの Partition Scheme「16M Flash (3MB APP/9.9MB FATFS)」の、9.9MB の FATFS の区画の /slide に入れます。
//   設定は /slide.cfg に入れます。プログラムとは別の場所なので、写真を出し入れしてもプログラムは消えません。
//
// 必要なもの:
//   ボードマネージャー M5Stack >= 3.3.7 / ボード: M5StopWatch(CoreS3 なら M5CoreS3)
//     ツール: Partition Scheme「16M Flash (3MB APP/9.9MB FATFS)」、USB CDC On Boot「Enabled」
//   ライブラリ M5Unified >= 0.2.15, M5GFX >= 0.2.21(JPEG を読むのは M5GFX の drawJpg)
//
// しくみ:
//   写真は2枚ぶんの置き場(PSRAM)に読んでおきます。いま見せている1枚と、次の1枚です。
//   切り替えるときは、2枚を混ぜたり(フェード)ずらしたり(スライド)しながら、16 行ずつの帯にして画面へ送ります。
//   「形」は、写真の上にかぶせる窓の形です(写真そのものは変わりません)。
//   USB の送り受けは NullGif と同じしくみ(「NMS …」で始まる1行の約束ごとと、2KB ずつのデータ)です。



// ---- 調整用 ----------------------------------------------------------------
static constexpr int   INFO_MS     = 2000;      // 切り替えたとき、下に「何枚目か」を出しておく時間
static constexpr int   FADE_MS     = 700;       // フェードにかける時間
static constexpr int   SLIDE_MS    = 550;       // スライドにかける時間
static constexpr int   HEART_MS    = 1200;      // ハートで切り替えるのにかける時間
static constexpr int   MENU_IDLE_MS = 12000;    // 設定の画面を、さわらなければこの時間でとじる
static constexpr int   CHUNK       = 2048;      // USB で受け取る1回ぶん(ここまで受け取ったら「受け取った」と返す)
static constexpr int   MAX_FILES   = 400;       // しまっておける写真の数
static constexpr int   GNAME_MAX   = 40;        // 名前の長さ(英数字と . _ -)
static constexpr int   MAX_JPG     = 600 * 1024; // 1枚の大きさの上限
static constexpr uint32_t WIFI_IDLE_MS = 180000; // Wi-Fi は、これだけ何もしなければ自動で切る(3分)
// ---------------------------------------------------------------------------

// StopWatch では、画面へ「直接」送る(M5GFX の PSRAM の置き場を通さない)。切り替えが速くなる。画面が乱れるときは false に
static constexpr bool DIRECT_SEND = true;
#if defined(ESP_PLATFORM) && defined(LGFX_USE_QSPI) && __has_include(<lgfx/v1/panel/Panel_AMOLED.hpp>)
#define NL_DIRECT_AMOLED 1
// 置き場(Panel_AMOLED_Framebuffer)が中に持っている、本物の画面(Panel_AMOLED)を取り出す
struct NlFbPeek : public lgfx::Panel_AMOLED_Framebuffer {
  static lgfx::Panel_AMOLED* inner(lgfx::Panel_Device* p) {
    return static_cast<lgfx::Panel_AMOLED_Framebuffer*>(p)->*(&NlFbPeek::_panel);
  }
};
#endif

static constexpr int BAND = 16;
#if defined(ESP_PLATFORM) || defined(NL_WIFI_TEST)
#define NL_WIFI 1
#else
#define NL_WIFI 0                                 // ブラウザのエミュレータには Wi-Fi はない
#endif

// 設定(本体のボタンでも、ページからでも変えられる)
static const char* const FX_NAME[]    = {"パッと", "フェード", "スライド", "ハート"};
static const uint16_t    SEC_VAL[]    = {3, 5, 10, 15, 30, 45, 60, 0};   // 0 = 手動(ボタンで送る)
static const char* const SEC_NAME[]   = {"3秒", "5秒", "10秒", "15秒", "30秒", "45秒", "1分", "手動"};
static const char* const ORD_NAME[]   = {"送った順", "ランダム"};
static const char* const SHAPE_NAME[] = {"そのまま", "ハート"};
static const uint8_t     BRIGHT_VAL[] = {60, 120, 190, 255};
static const char* const BRIGHT_NAME[] = {"1", "2", "3", "4"};
static constexpr int NFX = 4, NSEC = 8, NORD = 2, NSHAPE = 2, NBRIGHT = 4;
static int cfgFx = 1, cfgSec = 1, cfgBright = 2;
static constexpr size_t nmOa0 = nmAlignTo(nmOv0, alignof(int)), nmOv1 = nmOa0 + sizeof(int); static int& cfgOrd = *reinterpret_cast<int*>(NM_ARENA + nmOa0);
static constexpr size_t nmOa1 = nmAlignTo(nmOv1, alignof(int)), nmOv2 = nmOa1 + sizeof(int); static int& cfgShape = *reinterpret_cast<int*>(NM_ARENA + nmOa1);
static int cfgHcol = 1;  // ハートの色: 0 黒(なし) / 1 ピンク / 2 赤 / 3 むらさき / 4 水色 / 5 白
static const char* const HCOL_NAME[] = {"黒", "ピンク", "赤", "むらさき", "水色", "白"};
static const uint8_t HCOL_RGB[][3] = {{0, 0, 0}, {255, 120, 172}, {226, 44, 74}, {150, 96, 224}, {92, 200, 236}, {236, 236, 242}};
static constexpr int NHCOL = 6;
static constexpr size_t nmOa2 = nmAlignTo(nmOv2, alignof(bool)), nmOv3 = nmOa2 + sizeof(bool); static bool& cfgFlip = *reinterpret_cast<bool*>(NM_ARENA + nmOa2);  // 向き: true = さかさま(写真を 180 度回す)

static constexpr size_t nmOa3 = nmAlignTo(nmOv3, alignof(int)), nmOv4 = nmOa3 + sizeof(int); static int& W = *reinterpret_cast<int*>(NM_ARENA + nmOa3);
static constexpr size_t nmOa4 = nmAlignTo(nmOv4, alignof(int)), nmOv5 = nmOa4 + sizeof(int); static int& H = *reinterpret_cast<int*>(NM_ARENA + nmOa4);
static constexpr size_t nmOa5 = nmAlignTo(nmOv5, alignof(int)), nmOv6 = nmOa5 + sizeof(int); static int& S = *reinterpret_cast<int*>(NM_ARENA + nmOa5);
static constexpr size_t nmOa6 = nmAlignTo(nmOv6, alignof(int)), nmOv7 = nmOa6 + sizeof(int); static int& XOFF = *reinterpret_cast<int*>(NM_ARENA + nmOa6);
static constexpr size_t nmOa7 = nmAlignTo(nmOv7, alignof(int)), nmOv8 = nmOa7 + sizeof(int); static int& YOFF = *reinterpret_cast<int*>(NM_ARENA + nmOa7);
static constexpr size_t nmOa8 = nmAlignTo(nmOv8, alignof(int)), nmOv9 = nmOa8 + sizeof(int); static int& NB = *reinterpret_cast<int*>(NM_ARENA + nmOa8);
static bool roundScr = true;
static constexpr size_t nmOa9 = nmAlignTo(nmOv9, alignof(bool)), nmOv10 = nmOa9 + sizeof(bool); static bool& fbMode = *reinterpret_cast<bool*>(NM_ARENA + nmOa9);  // StopWatch で、M5GFX の置き場を通して送っているか
static constexpr size_t nmOa10 = nmAlignTo(nmOv10, alignof(bool)), nmOv11 = nmOa10 + sizeof(bool); static bool& directSend = *reinterpret_cast<bool*>(NM_ARENA + nmOa10);  // StopWatch で、画面へ直接送っているか

// ---- しまってある写真
static constexpr size_t nmOa11 = nmAlignTo(nmOv11, alignof(bool)), nmOv12 = nmOa11 + sizeof(bool); static bool& fsOk = *reinterpret_cast<bool*>(NM_ARENA + nmOa11);
static char     (*names)[GNAME_MAX + 1] = nullptr;   // [MAX_FILES]
static uint32_t* sizes = nullptr;
static uint16_t* order = nullptr;                 // 見せる順番(ランダムのときは混ぜたもの)
static constexpr size_t nmOa12 = nmAlignTo(nmOv12, alignof(int)), nmOv13 = nmOa12 + sizeof(int); static int& nFiles = *reinterpret_cast<int*>(NM_ARENA + nmOa12);
static int pos = -1;  // order の何番目を見せているか
static constexpr size_t nmOa13 = nmAlignTo(nmOv13, alignof(size_t)), nmOv14 = nmOa13 + sizeof(size_t); static size_t& fsTotal = *reinterpret_cast<size_t*>(NM_ARENA + nmOa13);
static constexpr size_t nmOa14 = nmAlignTo(nmOv14, alignof(size_t)), nmOv15 = nmOa14 + sizeof(size_t); static size_t& fsUsed = *reinterpret_cast<size_t*>(NM_ARENA + nmOa14);
static int nextSeq = 1;  // 次に送られる写真の番号(名前の頭の4けた)

// ---- 絵
static M5Canvas* spr[2] = {nullptr, nullptr};     // 写真2枚ぶん(PSRAM)
static M5Canvas* ui = nullptr;                    // 設定や文字の画面(PSRAM)
static M5Canvas* cap = nullptr;                   // 下に出す「何枚目か」(小さい)
static uint16_t* img[2] = {nullptr, nullptr};
static constexpr size_t nmOa15 = nmAlignTo(nmOv15, alignof(int)), nmOv16 = nmOa15 + sizeof(int); static int& ci = *reinterpret_cast<int*>(NM_ARENA + nmOa15);  // いま見せている写真は spr[ci]
static int       sprFile[2] = {-1, -1};           // その置き場に読んである写真の番号(-1 = なし)
static bool      sprOk[2] = {false, false};       // 読めたか
static uint8_t*  jpgBuf = nullptr;
static uint16_t* band[2] = {nullptr, nullptr};    // 画面へ送る帯(2つを交互に)
// 窓の形: 行ごとに2つまでの区間 [a0,a1] [b0,b1](ハートの上の方は2つに分かれる)
static float*    hTab = nullptr;                  // ハートの形: 高さごとの左右(大きさ 1 のとき)。[HN][4]
static constexpr int HN = 1024;
static constexpr float HV0 = -1.05f, HV1 = 1.30f;  // 表にする高さの範囲
static int16_t*  mk[2][4];                        // [0] = 画面(まる / 四角)、[1] = ハート
static int16_t*  mkBx[2];                         // 帯ごとの左はし(偶数)
static int16_t*  mkBw[2];                         // 帯ごとの幅(偶数)
static constexpr int CAPW = 160, CAPH = 34;
static constexpr size_t nmOa16 = nmAlignTo(nmOv16, alignof(int)), nmOv17 = nmOa16 + sizeof(int); static int& capX = *reinterpret_cast<int*>(NM_ARENA + nmOa16);
static constexpr size_t nmOa17 = nmAlignTo(nmOv17, alignof(int)), nmOv18 = nmOa17 + sizeof(int); static int& capY = *reinterpret_cast<int*>(NM_ARENA + nmOa17);

// ---- 動き
enum { M_SHOW = 0, M_TRANS = 1, M_MENU = 2, M_EMPTY = 3, M_WIFI = 4, M_CONFIRM = 5, M_USBINFO = 6 };
static int mode = M_EMPTY;
static int trDir = 1;
static constexpr size_t nmOa18 = nmAlignTo(nmOv18, alignof(int)), nmOv19 = nmOa18 + sizeof(int); static int& trKind = *reinterpret_cast<int*>(NM_ARENA + nmOa18);  // 切り替え中: 0 パッと / 1 フェード / 2 スライド / 3 ハート、向き
static constexpr size_t nmOa19 = nmAlignTo(nmOv19, alignof(uint32_t)), nmOv20 = nmOa19 + sizeof(uint32_t); static uint32_t& trT0 = *reinterpret_cast<uint32_t*>(NM_ARENA + nmOa19);
static constexpr size_t nmOa20 = nmAlignTo(nmOv20, alignof(int)), nmOv21 = nmOa20 + sizeof(int); static int& trTo = *reinterpret_cast<int*>(NM_ARENA + nmOa20);  // 切り替え先の pos
static constexpr size_t nmOa21 = nmAlignTo(nmOv21, alignof(bool)), nmOv22 = nmOa21 + sizeof(bool); static bool& trInfo = *reinterpret_cast<bool*>(NM_ARENA + nmOa21);
static constexpr size_t nmOa22 = nmAlignTo(nmOv22, alignof(uint32_t)), nmOv23 = nmOa22 + sizeof(uint32_t); static uint32_t& shownAt = *reinterpret_cast<uint32_t*>(NM_ARENA + nmOa22);  // いまの写真を出した時刻
static constexpr size_t nmOa23 = nmAlignTo(nmOv23, alignof(uint32_t)), nmOv24 = nmOa23 + sizeof(uint32_t); static uint32_t& infoUntil = *reinterpret_cast<uint32_t*>(NM_ARENA + nmOa23);
static constexpr size_t nmOa24 = nmAlignTo(nmOv24, alignof(bool)), nmOv25 = nmOa24 + sizeof(bool); static bool& infoOn = *reinterpret_cast<bool*>(NM_ARENA + nmOa24);
static constexpr size_t nmOa25 = nmAlignTo(nmOv25, alignof(int)), nmOv26 = nmOa25 + sizeof(int); static int& menuSel = *reinterpret_cast<int*>(NM_ARENA + nmOa25);
static constexpr size_t nmOa26 = nmAlignTo(nmOv26, alignof(uint32_t)), nmOv27 = nmOa26 + sizeof(uint32_t); static uint32_t& menuT = *reinterpret_cast<uint32_t*>(NM_ARENA + nmOa26);
static constexpr int MENU_N = 11;                 // 切り替え方 / 時間 / 順番 / 形 / ハートの色 / 向き / 明るさ / 消す / Wi-Fi / USB / とじる

// ---- Wi-Fi(本体が Wi-Fi を出す。ふだんは切っておく)
#if NL_WIFI
static WebServer* web = nullptr;
#endif
static constexpr size_t nmOa27 = nmAlignTo(nmOv27, alignof(bool)), nmOv28 = nmOa27 + sizeof(bool); static bool& wifiOn = *reinterpret_cast<bool*>(NM_ARENA + nmOa27);
static constexpr size_t nmOa28 = nmAlignTo(nmOv28, alignof(uint32_t)), nmOv29 = nmOa28 + sizeof(uint32_t); static uint32_t& wifiLast = *reinterpret_cast<uint32_t*>(NM_ARENA + nmOa28);  // 最後に何かあった時刻(ここから3分で切る)
static constexpr size_t nmOa29 = nmAlignTo(nmOv29, alignof(int)), nmOv30 = nmOa29 + sizeof(int); static int& wifiQr = *reinterpret_cast<int*>(NM_ARENA + nmOa29);  // 0 = Wi-Fi に入る QR / 1 = ページの QR
static int wifiSta = -1;  // つながっている台数
static int wifiShownMin = -1;
static constexpr size_t nmOa30 = nmAlignTo(nmOv30, alignof(bool)), nmOv31 = nmOa30 + sizeof(bool); static bool& wifiDirty = *reinterpret_cast<bool*>(NM_ARENA + nmOa30);  // 画面を描き直す
static constexpr size_t nmOa31 = nmAlignTo(nmOv31, alignof(uint32_t)), nmOv32 = nmOa31 + sizeof(uint32_t); static uint32_t& wifiPeekUntil = *reinterpret_cast<uint32_t*>(NM_ARENA + nmOa31);  // 「見せる」で写真を少しのあいだ出している
static constexpr size_t nmOa32 = nmAlignTo(nmOv32, 16), nmOv33 = nmOa32 + sizeof(char[24]); static char (&wifiSsid)[24] = *reinterpret_cast<char(*)[24]>(NM_ARENA + nmOa32);
static constexpr size_t nmOa33 = nmAlignTo(nmOv33, 16), nmOv34 = nmOa33 + sizeof(char[12]); static char (&wifiPass)[12] = *reinterpret_cast<char(*)[12]>(NM_ARENA + nmOa33);
static constexpr size_t nmOa34 = nmAlignTo(nmOv34, 16), nmOv35 = nmOa34 + sizeof(char[64]); static char (&wifiMsg)[64] = *reinterpret_cast<char(*)[64]>(NM_ARENA + nmOa34);
static File*    upFile = nullptr;                 // Wi-Fi で受け取っている写真
static const char* upErr = nullptr;
static constexpr size_t nmOa35 = nmAlignTo(nmOv35, alignof(uint32_t)), nmOv36 = nmOa35 + sizeof(uint32_t); static uint32_t& upGot = *reinterpret_cast<uint32_t*>(NM_ARENA + nmOa35);
static constexpr size_t nmOa36 = nmAlignTo(nmOv36, alignof(uint32_t)), nmOv37 = nmOa36 + sizeof(uint32_t); static uint32_t& upSize = *reinterpret_cast<uint32_t*>(NM_ARENA + nmOa36);
static constexpr size_t nmOa37 = nmAlignTo(nmOv37, alignof(uint32_t)), nmOv38 = nmOa37 + sizeof(uint32_t); static uint32_t& upShownMs = *reinterpret_cast<uint32_t*>(NM_ARENA + nmOa37);
static constexpr size_t nmOa38 = nmAlignTo(nmOv38, 16), nmOv39 = nmOa38 + sizeof(char[GNAME_MAX + 1]); static char (&upName)[GNAME_MAX + 1] = *reinterpret_cast<char(*)[GNAME_MAX + 1]>(NM_ARENA + nmOa38);

// ---- USB
static constexpr size_t nmOa39 = nmAlignTo(nmOv39, 16), nmOv40 = nmOa39 + sizeof(char[160]); static char (&line)[160] = *reinterpret_cast<char(*)[160]>(NM_ARENA + nmOa39);
static constexpr size_t nmOa40 = nmAlignTo(nmOv40, alignof(int)), nmOv41 = nmOa40 + sizeof(int); static int& lineLen = *reinterpret_cast<int*>(NM_ARENA + nmOa40);
static File*     rxFile = nullptr;
static constexpr size_t nmOa41 = nmAlignTo(nmOv41, alignof(bool)), nmOv42 = nmOa41 + sizeof(bool); static bool& rxActive = *reinterpret_cast<bool*>(NM_ARENA + nmOa41);
static constexpr size_t nmOa42 = nmAlignTo(nmOv42, alignof(bool)), nmOv43 = nmOa42 + sizeof(bool); static bool& rxWaitDone = *reinterpret_cast<bool*>(NM_ARENA + nmOa42);
static constexpr size_t nmOa43 = nmAlignTo(nmOv43, alignof(uint32_t)), nmOv44 = nmOa43 + sizeof(uint32_t); static uint32_t& rxSize = *reinterpret_cast<uint32_t*>(NM_ARENA + nmOa43);
static constexpr size_t nmOa44 = nmAlignTo(nmOv44, alignof(uint32_t)), nmOv45 = nmOa44 + sizeof(uint32_t); static uint32_t& rxGot = *reinterpret_cast<uint32_t*>(NM_ARENA + nmOa44);
static constexpr size_t nmOa45 = nmAlignTo(nmOv45, alignof(uint32_t)), nmOv46 = nmOa45 + sizeof(uint32_t); static uint32_t& rxSinceAck = *reinterpret_cast<uint32_t*>(NM_ARENA + nmOa45);
static constexpr size_t nmOa46 = nmAlignTo(nmOv46, alignof(uint32_t)), nmOv47 = nmOa46 + sizeof(uint32_t); static uint32_t& rxCrc = *reinterpret_cast<uint32_t*>(NM_ARENA + nmOa46);
static constexpr size_t nmOa47 = nmAlignTo(nmOv47, alignof(uint32_t)), nmOv48 = nmOa47 + sizeof(uint32_t); static uint32_t& rxLast = *reinterpret_cast<uint32_t*>(NM_ARENA + nmOa47);
static constexpr size_t nmOa48 = nmAlignTo(nmOv48, 16), nmOv49 = nmOa48 + sizeof(char[GNAME_MAX + 1]); static char (&rxName)[GNAME_MAX + 1] = *reinterpret_cast<char(*)[GNAME_MAX + 1]>(NM_ARENA + nmOa48);
static uint8_t*  rxBuf = nullptr;
static int rxShownPct = -1;
static constexpr size_t nmOa49 = nmAlignTo(nmOv49, alignof(uint32_t)), nmOv50 = nmOa49 + sizeof(uint32_t); static uint32_t& rxShownMs = *reinterpret_cast<uint32_t*>(NM_ARENA + nmOa49);

// ---------------------------------------------------------------- 道具
static inline uint16_t rgb(int r, int g, int b) { return M5.Display.color565(r, g, b); }
static void fmtMB(char* o, size_t n, size_t bytes) { snprintf(o, n, "%.1fMB", bytes / 1048576.0); }

// CRC32(PC から送られた写真が、途中で化けていないか確かめる)
static uint32_t crcAdd(uint32_t crc, const uint8_t* p, size_t n) {
  static const uint32_t T[16] = {
    0x00000000, 0x1DB71064, 0x3B6E20C8, 0x26D930AC, 0x76DC4190, 0x6B6B51F4, 0x4DB26158, 0x5005713C,
    0xEDB88320, 0xF00F9344, 0xD6D6A3E8, 0xCB61B38C, 0x9B64C2B0, 0x86D3D2D4, 0xA00AE278, 0xBDBDF21C };
  crc = ~crc;
  for (size_t i = 0; i < n; ++i) {
    crc ^= p[i];
    crc = (crc >> 4) ^ T[crc & 15];
    crc = (crc >> 4) ^ T[crc & 15];
  }
  return ~crc;
}

// 名前は英数字と . _ - だけ、.jpg で終わるもの
static bool goodName(const char* s) {
  int n = (int)strlen(s);
  if (n < 5 || n > GNAME_MAX) return false;
  for (int i = 0; i < n; ++i) {
    char c = s[i];
    if (!((c >= 'a' && c <= 'z') || (c >= 'A' && c <= 'Z') || (c >= '0' && c <= '9') || c == '.' || c == '_' || c == '-')) return false;
  }
  if (s[0] == '.' || s[0] == '~') return false;
  const char* e = s + n - 4;
  return (e[0] == '.') && (e[1] == 'j' || e[1] == 'J') && (e[2] == 'p' || e[2] == 'P') && (e[3] == 'g' || e[3] == 'G');
}

// JPEG の大きさを読む。TJpgDec が読めない形(プログレッシブなど)なら false
static bool jpgSize(const uint8_t* p, size_t n, int* w, int* h) {
  if (n < 4 || p[0] != 0xFF || p[1] != 0xD8) return false;
  size_t i = 2;
  while (i + 9 < n) {
    if (p[i] != 0xFF) { ++i; continue; }
    const uint8_t m = p[i + 1];
    if (m == 0xFF) { ++i; continue; }
    if (m == 0xD8 || m == 0x01 || (m >= 0xD0 && m <= 0xD7)) { i += 2; continue; }
    const size_t len = ((size_t)p[i + 2] << 8) | p[i + 3];
    if (m >= 0xC0 && m <= 0xCF && m != 0xC4 && m != 0xC8 && m != 0xCC) {
      *h = (p[i + 5] << 8) | p[i + 6]; *w = (p[i + 7] << 8) | p[i + 8];
      return (m == 0xC0 || m == 0xC1) && *w > 0 && *h > 0;
    }
    i += 2 + len;
  }
  return false;
}

// ---------------------------------------------------------------- 設定
static void saveCfg() {
  if (!fsOk) return;
  File f = FFat.open("/slide.cfg", "w");
  if (!f) return;
  char s[48]; snprintf(s, sizeof(s), "NSCFG 4 %d %d %d %d %d %d %d\n", cfgFx, cfgSec, cfgOrd, cfgShape, cfgBright, cfgFlip ? 1 : 0, cfgHcol);
  f.write((const uint8_t*)s, strlen(s));
  f.close();
}
static void loadCfg() {
  if (!fsOk) return;
  File f = FFat.open("/slide.cfg", "r");
  if (!f) return;
  char s[48] = {0};
  f.read((uint8_t*)s, sizeof(s) - 1);
  f.close();
  int v, a, b, c, d, e, fl = 0;
  int hc = 1;
  const int got = sscanf(s, "NSCFG %d %d %d %d %d %d %d %d", &v, &a, &b, &c, &d, &e, &fl, &hc);
  if (got >= 6 && v >= 1 && v <= 4) {
    if (v >= 4 && got >= 8 && hc >= 0 && hc < NHCOL) cfgHcol = hc;
    if (v >= 3 && got >= 7) cfgFlip = fl != 0;
    static const int8_t OLD_SEC[] = {0, 1, 2, 4, 6, 7};   // v1/v2 のときの「1枚の時間」の番号 → 今の番号
    if (v == 1) b = (b >= 0 && b < 6) ? OLD_SEC[b] : 1;
    if (a >= 0 && a < NFX) cfgFx = a;
    if (b >= 0 && b < NSEC) cfgSec = b;
    if (c >= 0 && c < NORD) cfgOrd = c;
    if (d >= 0 && d < NSHAPE) cfgShape = d;
    if (e >= 0 && e < NBRIGHT) cfgBright = e;
  }
}
static void reply(const char* s) { Serial.print(s); Serial.print("\n"); }
static void sendCfg() {                           // ページへ、いまの設定を知らせる
  char o[48]; snprintf(o, sizeof(o), "NMS CFG %d %d %d %d %d", cfgFx, cfgSec, cfgOrd, cfgShape, cfgBright); reply(o);
}

// ---------------------------------------------------------------- しまう場所
static void fsStats() {
  if (!fsOk) { fsTotal = fsUsed = 0; return; }
  fsTotal = FFat.totalBytes(); fsUsed = FFat.usedBytes();
}
static void shuffleOrder() {
  for (int i = 0; i < nFiles; ++i) order[i] = (uint16_t)i;
  if (cfgOrd == 1)
    for (int i = nFiles - 1; i > 0; --i) { int j = (int)(esp_random() % (uint32_t)(i + 1)); uint16_t t = order[i]; order[i] = order[j]; order[j] = t; }
}
static void scanFiles() {
  nFiles = 0; nextSeq = 1;
  if (!fsOk) return;
  File dir = FFat.open("/slide");
  if (!dir || !dir.isDirectory()) return;
  for (File f = dir.openNextFile(); f && nFiles < MAX_FILES; f = dir.openNextFile()) {
    if (f.isDirectory()) continue;
    const char* nm = f.name();
    const char* slash = strrchr(nm, '/');
    if (slash) nm = slash + 1;
    if (!goodName(nm)) continue;
    strncpy(names[nFiles], nm, GNAME_MAX); names[nFiles][GNAME_MAX] = 0;
    sizes[nFiles] = (uint32_t)f.size();
    const int sq = atoi(nm);                      // 頭の数字(ページが「送った順」の番号をつけて送る)
    if (sq >= nextSeq) nextSeq = sq + 1;
    ++nFiles;
  }
  // 名前の順(= 送った順)に並べる
  for (int i = 1; i < nFiles; ++i)
    for (int j = i; j > 0 && strcmp(names[j - 1], names[j]) > 0; --j) {
      char t[GNAME_MAX + 1]; strcpy(t, names[j]); strcpy(names[j], names[j - 1]); strcpy(names[j - 1], t);
      uint32_t z = sizes[j]; sizes[j] = sizes[j - 1]; sizes[j - 1] = z;
    }
  fsStats();
}
static int findFile(const char* nm) {
  for (int i = 0; i < nFiles; ++i) if (!strcmp(names[i], nm)) return i;
  return -1;
}
static int posOfFile(int fi) {
  for (int i = 0; i < nFiles; ++i) if (order[i] == fi) return i;
  return 0;
}
// 写真の一覧が変わった: 番号がずれるので、読んである写真は忘れる。見せていた写真は名前で探し直す
static void filesChanged(const char* keep) {
  sprFile[0] = sprFile[1] = -1;
  shuffleOrder();
  const int fi = keep && keep[0] ? findFile(keep) : -1;
  pos = fi >= 0 ? posOfFile(fi) : (nFiles ? 0 : -1);
}

// ---------------------------------------------------------------- 窓の形
// 行 y の区間を決める(ハートは (x²+y²-1)³ - x²y³ <= 0 の形)
static void buildMasks() {
  const float c = (S - 1) * 0.5f, rr = S * 0.5f + 1.0f;
  for (int y = 0; y < S; ++y) {                   // [0] 画面: 丸い画面はまる、四角い画面は四角いっぱい
    int16_t a0 = 0, a1 = S - 1;
    if (roundScr) {
      const float dy = y - c, w = rr * rr - dy * dy;
      if (w <= 0) { a0 = 1; a1 = 0; }
      else { const float s = sqrtf(w); a0 = (int16_t)max(0, (int)floorf(c - s)); a1 = (int16_t)min(S - 1, (int)ceilf(c + s)); }
    }
    mk[0][0][y] = a0; mk[0][1][y] = a1; mk[0][2][y] = 1; mk[0][3][y] = 0;
  }
  // ハート: 丸い画面では、まるの中にいちばん大きく入るように。四角い画面では、正方形にいちばん大きく
  const float k  = roundScr ? (S * 0.5f - 5.0f) / 1.25f : (S - 8.0f) / 2.28f;   // 1 あたりの点の数
  const float vc = roundScr ? 0.25f : 0.118f;                                   // 画面のまん中が、ハートのどの高さか
  for (int y = 0; y < S; ++y) {
    const float v = (S * 0.5f - (y + 0.5f)) / k + vc;
    int runs[2][2]; int nr = 0; bool in = false; int st = 0;
    for (int x = 0; x <= S; ++x) {
      bool h = false;
      if (x < S) {
        const float u = (x + 0.5f - S * 0.5f) / k;
        const float q = u * u + v * v - 1.0f;
        h = q * q * q - u * u * v * v * v <= 0.0f;
        if (h && !(mk[0][0][y] <= x && x <= mk[0][1][y])) h = false;
      }
      if (h && !in) { in = true; st = x; }
      if (!h && in) { in = false; if (nr < 2) { runs[nr][0] = st; runs[nr][1] = x - 1; ++nr; } }
    }
    mk[1][0][y] = nr > 0 ? runs[0][0] : 1; mk[1][1][y] = nr > 0 ? runs[0][1] : 0;
    mk[1][2][y] = nr > 1 ? runs[1][0] : 1; mk[1][3][y] = nr > 1 ? runs[1][1] : 0;
  }
  if (cfgFlip) {                                  // さかさま: ハートの窓も上下を逆に
    for (int k = 0; k < 4; ++k) for (int y = 0, j = S - 1; y < j; ++y, --j) { const int16_t t = mk[1][k][y]; mk[1][k][y] = mk[1][k][j]; mk[1][k][j] = t; }
  }
  // 帯ごとの左右(StopWatch の画面へ直接送るときは、x と幅が偶数でないと描かれない)
  for (int m = 0; m < 1; ++m)                     // (ハートのぶんは使わないので、画面のぶんだけ)
    for (int b = 0; b < NB; ++b) {
      int x0 = S, x1 = -1;
      for (int y = b * BAND; y < min(S, (b + 1) * BAND); ++y) {
        if (mk[m][0][y] <= mk[m][1][y]) { x0 = min(x0, (int)mk[m][0][y]); x1 = max(x1, (int)mk[m][1][y]); }
        if (mk[m][2][y] <= mk[m][3][y]) { x0 = min(x0, (int)mk[m][2][y]); x1 = max(x1, (int)mk[m][3][y]); }
      }
      if (x1 < x0) { mkBx[m][b] = 0; mkBw[m][b] = 0; continue; }
      x0 &= ~1; x1 |= 1; if (x1 > S - 1) x1 = S - 1;
      mkBx[m][b] = (int16_t)x0; mkBw[m][b] = (int16_t)((x1 - x0 + 1) & ~1);
    }
}

// ハートの形の表(切り替えの「ハート」で、大きさを変えながら使う)
static void buildHeartTab() {
  for (int i = 0; i < HN; ++i) {
    const float v = HV0 + (i + 0.5f) * (HV1 - HV0) / HN;
    float r[4] = {1, 0, 1, 0}; int nr = 0; bool in = false; float st = 0;
    const int NU = 1200;
    for (int j = 0; j <= NU; ++j) {
      const float u = -1.3f + j * (2.6f / NU);
      bool h = false;
      if (j < NU) { const float q = u * u + v * v - 1.0f; h = q * q * q - u * u * v * v * v <= 0.0f; }
      if (h && !in) { in = true; st = u; }
      if (!h && in) { in = false; if (nr < 2) { r[nr * 2] = st; r[nr * 2 + 1] = u; ++nr; } }
    }
    for (int k = 0; k < 4; ++k) hTab[i * 4 + k] = r[k];
  }
}

// ---------------------------------------------------------------- 画面へ
// 2つの色(バイトを入れ替えた 565)を a/32 で混ぜる
static inline uint16_t mix565(uint16_t p, uint16_t q, uint32_t a) {
  uint32_t x = __builtin_bswap16(p), y = __builtin_bswap16(q);
  x = (x | (x << 16)) & 0x07E0F81Fu;
  y = (y | (y << 16)) & 0x07E0F81Fu;
  uint32_t r = ((x * (32 - a) + y * a) >> 5) & 0x07E0F81Fu;
  return __builtin_bswap16((uint16_t)(r | (r >> 16)));
}

enum { K_IMG = 0, K_FADE = 1, K_SLIDE = 2, K_UI = 3, K_HEART = 4 };
static constexpr size_t nmOa50 = nmAlignTo(nmOv50, alignof(uint16_t)), nmOv51 = nmOa50 + sizeof(uint16_t); static uint16_t& hcolPix = *reinterpret_cast<uint16_t*>(NM_ARENA + nmOa50);  // ハートの色(画面へ送る形)
// 1行 [s, e] を作る(out は x = bx の位置から)
static inline void spanRow(uint16_t* out, int bx, int y, int s, int e, int kind, int prm, int dir) {
  if (s > e) return;
  const uint16_t* A = (kind == K_UI ? (const uint16_t*)ui->getBuffer() : img[ci]) + (size_t)y * S;
  uint16_t* o = out + (s - bx);
  const int n = e - s + 1;
  if (kind == K_IMG || kind == K_UI) { memcpy(o, A + s, n * 2); return; }
  const uint16_t* B = img[1 - ci] + (size_t)y * S;
  if (kind == K_FADE) { for (int i = 0; i < n; ++i) o[i] = mix565(A[s + i], B[s + i], (uint32_t)prm); return; }
  if (kind == K_HEART) {                          // ハート: うしろは次の写真。いまの写真は、小さくなるハートの中だけに、だんだん薄く
    memcpy(o, B + s, n * 2);
    const float t = prm * (1.0f / 4096.0f);
    const float k = S * 1.15f * (1.0f - t) * (1.0f - t * 0.25f);   // 1 あたりの点の数(はじめは画面より大きい)
    const uint32_t full = (uint32_t)((1.0f - t * t) * 32.0f + 0.5f);
    if (k < 1.0f || full == 0) return;
    const int yy = cfgFlip ? S - 1 - y : y;      // さかさまのときは、ハートも上下を逆に
    const float cx = S * 0.5f, EDGE = 3.0f;
    if (cfgHcol != 0) {                          // ふちの色: 少し大きいハートを、選んだ色で先に塗る
      const float kr = k + 12.0f;
      const float vr = (S * 0.5f - (yy + 0.5f)) / kr + 0.18f;
      const int hr = (int)((vr - HV0) * (HN / (HV1 - HV0)));
      const uint32_t ar = (uint32_t)((1.0f - t * t) * 26.0f + 0.5f);
      if (hr >= 0 && hr < HN && ar) {
        const float* rr = hTab + hr * 4;
        for (int q = 0; q < 2; ++q) {
          if (rr[q * 2 + 1] <= rr[q * 2]) continue;
          const int x0 = max(s, (int)ceilf(cx + rr[q * 2] * kr - 0.5f)), x1 = min(e, (int)floorf(cx + rr[q * 2 + 1] * kr - 0.5f));
          for (int x = x0; x <= x1; ++x) o[x - s] = mix565(o[x - s], hcolPix, ar);
        }
      }
    }
    const float v = (S * 0.5f - (yy + 0.5f)) / k + 0.18f;
    const int hi = (int)((v - HV0) * (HN / (HV1 - HV0)));
    if (hi < 0 || hi >= HN) return;
    const float* r = hTab + hi * 4;
    for (int q = 0; q < 2; ++q) {
      if (r[q * 2 + 1] <= r[q * 2]) continue;
      const float xa = cx + r[q * 2] * k, xb = cx + r[q * 2 + 1] * k;   // この行の、ハートの左右
      const int x0 = max(s, (int)ceilf(xa - 0.5f)), x1 = min(e, (int)floorf(xb - 0.5f));
      for (int x = x0; x <= x1; ++x) {
        const float d = fminf(x + 0.5f - xa, xb - (x + 0.5f));
        const uint32_t a = d >= EDGE ? full : (uint32_t)(full * d * (1.0f / EDGE));   // ふちはぼかす
        if (d >= EDGE) o[x - s] = mix565(B[s + (x - s)], A[s + (x - s)], a);
        else if (a) o[x - s] = mix565(o[x - s], A[s + (x - s)], a);        // ふちは、ふちの色からなめらかに
      }
    }
    return;
  }
  // スライド: dir=1 なら、いまの写真が左へ出ていき、次の写真が右から入る
  for (int x = s; x <= e;) {
    int sx = dir > 0 ? x + prm : x - prm;
    const uint16_t* src; int lim;
    if (dir > 0) { if (sx < S) { src = A + sx; lim = S - sx; } else { src = B + (sx - S); lim = 2 * S - sx; } }
    else         { if (sx >= 0) { src = A + sx; lim = S - sx; } else { src = B + (sx + S); lim = -sx; } }
    const int k = min(e - x + 1, lim);
    memcpy(out + (x - bx), src, k * 2);
    x += k;
  }
}

// 画面ぜんぶを作って送る。kind: K_IMG(いまの写真) / K_FADE(prm = 0..32) / K_SLIDE(prm = ずらす点の数) / K_UI(文字の画面)
//   / K_HEART(prm = 0..4096 の進み)
static void present(int kind, int prm = 0, int dir = 1) {
  const int m = (kind == K_UI || cfgShape == 0) ? 0 : 1;
  hcolPix = __builtin_bswap16(rgb(HCOL_RGB[cfgHcol][0], HCOL_RGB[cfgHcol][1], HCOL_RGB[cfgHcol][2]));   // 帯の中は、バイトを入れかえた形
  const bool capOn = infoOn && kind != K_UI;
  if (!fbMode) M5.Display.startWrite();
  int slot = 0;
  for (int b = 0; b < NB; ++b) {
    const int y0 = b * BAND, h = min(BAND, S - y0);
    int bx = mkBx[0][b], bw = mkBw[0][b];          // 画面の中ぜんぶを送る(ハートの外は黒で塗る)
    const bool capRows = capOn && y0 < capY + CAPH && y0 + h > capY;
    if (capRows) { const int x1 = max(bx + bw, capX + CAPW); bx = min(bx, capX); bw = x1 - bx; }
    if (bw <= 0) continue;
    uint16_t* out = band[slot];
    for (int y = y0; y < y0 + h; ++y) {
      uint16_t* o = out + (y - y0) * bw;
      memset(o, 0, bw * 2);
      if (m == 1 && cfgHcol != 0) {               // ハートのまわりを、選んだ色で塗る
        const int a0 = max((int)mk[0][0][y], bx), a1 = min((int)mk[0][1][y], bx + bw - 1);
        for (int x = a0; x <= a1; ++x) o[x - bx] = hcolPix;
      }
      spanRow(o, bx, y, max((int)mk[m][0][y], bx), min((int)mk[m][1][y], bx + bw - 1), kind, prm, dir);
      spanRow(o, bx, y, max((int)mk[m][2][y], bx), min((int)mk[m][3][y], bx + bw - 1), kind, prm, dir);
      if (capRows && y >= capY && y < capY + CAPH)
        memcpy(o + (capX - bx), (const uint16_t*)cap->getBuffer() + (y - capY) * CAPW, CAPW * 2);
    }
    if (fbMode) M5.Display.pushImage(XOFF + bx, YOFF + y0, bw, h, out);
    else { M5.Display.waitDMA(); M5.Display.pushImageDMA(XOFF + bx, YOFF + y0, bw, h, out); }
    slot ^= 1;
  }
  if (!fbMode) { M5.Display.waitDMA(); M5.Display.endWrite(); }
}

// ui に、まん中に何行かの文字(写真がないときなど)
static void uiMessage(const char* const* lines, int n) {
  ui->fillSprite(TFT_BLACK);
  ui->setFont(S >= 400 ? &fonts::lgfxJapanGothicP_20 : &fonts::lgfxJapanGothicP_16);
  ui->setTextDatum(middle_center);
  const int lh = S >= 400 ? 30 : 22;
  for (int i = 0; i < n; ++i) {
    ui->setTextColor(i == 0 ? TFT_WHITE : rgb(170, 170, 178));
    ui->drawString(lines[i], S / 2, (int)(S / 2 + (i - (n - 1) * 0.5f) * lh));
  }
  present(K_UI);
}
static void showEmpty() {
  if (mode == M_WIFI) { wifiDirty = true; return; }  // Wi-Fi の画面のまま
  mode = M_EMPTY;
  if (!fsOk) {
    const char* L[] = {"写真の置き場がありません", "Partition Scheme を", "16M Flash (3MB APP/9.9MB FATFS)", "にして書き込んでください"};
    uiMessage(L, 4); return;
  }
  char c[48], a[16], b[16];
  fmtMB(a, sizeof(a), fsTotal > fsUsed ? fsTotal - fsUsed : 0); fmtMB(b, sizeof(b), fsTotal);
  snprintf(c, sizeof(c), "残り %s / %s", a, b);
  const char* L[] = {"写真がありません", roundScr ? "設定(ボタン B)から" : "設定(電源ボタン)から", "Wi-Fi か USB で送れます", "(写真は 400 枚まで。容量しだい)", c};
  uiMessage(L, 5);
}

// 下に「何枚目か」
static void setInfo() {
  char s[32]; snprintf(s, sizeof(s), "%d / %d", pos + 1, nFiles);
  cap->fillSprite(TFT_BLACK);
  cap->fillRect(0, 0, CAPW, CAPH, rgb(16, 18, 24));
  cap->setFont(&fonts::lgfxJapanGothicP_20);
  cap->setTextDatum(middle_center);
  cap->setTextColor(TFT_WHITE);
  cap->drawString(s, CAPW / 2, CAPH / 2);
  infoOn = true; infoUntil = millis() + INFO_MS;
}

// ---------------------------------------------------------------- 写真を読む
// 写真 fi を spr[k] に読む(写真がなければ黒)
static bool loadPhoto(int fi, int k) {
  if (sprFile[k] == fi && fi >= 0) return sprOk[k];
  sprFile[k] = fi; sprOk[k] = false;
  spr[k]->fillSprite(TFT_BLACK);
  if (fi < 0 || fi >= nFiles) return false;
  char path[64]; snprintf(path, sizeof(path), "/slide/%s", names[fi]);
  File f = FFat.open(path, "r");
  if (!f) return false;
  const size_t n = f.size();
  if (n == 0 || n > (size_t)MAX_JPG) { f.close(); return false; }
  const size_t got = f.read(jpgBuf, n);
  f.close();
  int w = 0, h = 0;
  if (got != n || !jpgSize(jpgBuf, n, &w, &h)) { Serial.printf("# cannot read %s\n", names[fi]); return false; }
  float sc = 1.0f;                                // 画面より大きいときだけ縮める(ふつうはページが画面の大きさにしてある)
  if (w > S || h > S) sc = fminf((float)S / w, (float)S / h);
  const int dw = (int)(w * sc), dh = (int)(h * sc);
  const uint32_t t0 = millis();
  sprOk[k] = spr[k]->drawJpg(jpgBuf, (uint32_t)n, (S - dw) / 2, (S - dh) / 2, 0, 0, 0, 0, sc, sc);
  if (cfgFlip) {                                  // さかさま: 並びを逆にすると 180 度回る
    uint16_t* p = img[k];
    for (size_t i = 0, j = (size_t)S * S - 1; i < j; ++i, --j) { const uint16_t t = p[i]; p[i] = p[j]; p[j] = t; }
  }
  Serial.printf("# photo %s  %dx%d  %u ms%s\n", names[fi], w, h, (unsigned)(millis() - t0), sprOk[k] ? "" : "  (failed)");
  return sprOk[k];
}

static int wrapPos(int p) { return nFiles ? ((p % nFiles) + nFiles) % nFiles : -1; }
// 写真 pos を、パッと出す
static void showNow(int p) {
  if (nFiles <= 0) { pos = -1; showEmpty(); return; }
  pos = wrapPos(p);
  const int fi = order[pos];
  if (sprFile[1 - ci] == fi) ci = 1 - ci;         // 次の写真として読んであった
  loadPhoto(fi, ci);
  setInfo();
  present(K_IMG);
  if (mode == M_WIFI) { wifiPeekUntil = (millis() + 4000) | 1; return; }   // 4秒見せたら Wi-Fi の画面に戻る
  mode = M_SHOW; shownAt = millis();
}
// 次(dir=1)/ 前(dir=-1)の写真へ、決めた切り替え方で
static void goTo(int p, int dir, bool showInfo) {
  if (nFiles <= 0) return;
  if (nFiles == 1) { showNow(0); return; }
  if (dir > 0 && wrapPos(p) == 0 && cfgOrd == 1) {   // ランダムで一回りした: 混ぜ直す(同じ写真が続かないように)
    const int last = order[pos];
    shuffleOrder();
    if (order[0] == last) { order[0] = order[nFiles - 1]; order[nFiles - 1] = (uint16_t)last; }
    sprFile[1 - ci] = -1;
  }
  trTo = wrapPos(p);
  loadPhoto(order[trTo], 1 - ci);
  infoOn = false;
  if (cfgFx == 0) { ci = 1 - ci; pos = trTo; if (showInfo) setInfo(); present(K_IMG); mode = M_SHOW; shownAt = millis(); return; }
  trKind = cfgFx; trDir = dir; trT0 = millis(); mode = M_TRANS;
  trInfo = showInfo;                              // 切り替え終わったら「何枚目か」を出す
}
static void stepTrans() {
  const uint32_t dur = trKind == 1 ? FADE_MS : trKind == 3 ? HEART_MS : SLIDE_MS;
  const uint32_t el = millis() - trT0;
  if (el >= dur) {
    ci = 1 - ci; pos = trTo;
    if (trInfo) setInfo();
    present(K_IMG);
    mode = M_SHOW; shownAt = millis();
    return;
  }
  float t = el / (float)dur;
  t = t * t * (3.0f - 2.0f * t);                  // はじめと終わりをゆっくり
  if (trKind == 1) present(K_FADE, (int)(t * 32.0f + 0.5f));
  else if (trKind == 3) present(K_HEART, (int)(t * 4096.0f + 0.5f));
  else             present(K_SLIDE, (int)(t * S + 0.5f), trDir);
}

// ---------------------------------------------------------------- 設定の画面
static void menuValue(int i, char* o, size_t n) {
  switch (i) {
    case 0: snprintf(o, n, "%s", FX_NAME[cfgFx]); break;
    case 1: snprintf(o, n, "%s", SEC_NAME[cfgSec]); break;
    case 2: snprintf(o, n, "%s", ORD_NAME[cfgOrd]); break;
    case 3: snprintf(o, n, "%s", SHAPE_NAME[cfgShape]); break;
    case 4: snprintf(o, n, "%s", HCOL_NAME[cfgHcol]); break;
    case 5: snprintf(o, n, "%s", cfgFlip ? "さかさま" : "そのまま"); break;
    case 6: snprintf(o, n, "%s", BRIGHT_NAME[cfgBright]); break;
    case 7: case 8: case 9: snprintf(o, n, "%s", "→"); break;
    default: o[0] = 0; break;
  }
}
static const char* const MENU_LABEL[MENU_N] = {"切り替え方", "1枚の時間", "順番", "形", "ハートの色", "向き", "明るさ", "この写真を消す", "Wi-Fi で受け取る", "USB で受け取る", "とじる"};
static int menuRowH() { return S >= 400 ? 30 : 17; }
static int menuY0()   { return S / 2 - (MENU_N * menuRowH()) / 2 + menuRowH() / 2 + (S >= 400 ? 8 : 6); }
static void drawMenu() {
  const bool big = S >= 400;
  ui->fillSprite(TFT_BLACK);
  ui->setFont(big ? &fonts::lgfxJapanGothicP_24 : &fonts::lgfxJapanGothicP_20);
  ui->setTextDatum(middle_center);
  ui->setTextColor(rgb(255, 170, 200));
  ui->drawString("設定", S / 2, menuY0() - menuRowH() - (big ? 8 : 4));
  ui->setFont(big ? &fonts::lgfxJapanGothicP_20 : &fonts::lgfxJapanGothicP_16);
  const int rw = big ? 300 : 220, rh = menuRowH(), x0 = S / 2 - rw / 2;
  for (int i = 0; i < MENU_N; ++i) {
    const int y = menuY0() + i * rh;
    const bool on = i == menuSel;
    if (on) ui->fillRect(x0, y - rh / 2 + 3, rw, rh - 6, rgb(60, 34, 48));
    if (i == MENU_N - 1) {
      ui->setTextDatum(middle_center);
      ui->setTextColor(on ? TFT_WHITE : rgb(150, 150, 160));
      ui->drawString(MENU_LABEL[i], S / 2, y);
      continue;
    }
    char v[24]; menuValue(i, v, sizeof(v));
    ui->setTextDatum(middle_left);
    ui->setTextColor(on ? TFT_WHITE : rgb(170, 170, 180));
    ui->drawString(MENU_LABEL[i], x0 + 12, y);
    ui->setTextColor(on ? rgb(255, 170, 200) : rgb(220, 220, 228));
    ui->drawString(v, x0 + rw - 12 - ui->textWidth(v), y);
  }
  ui->setFont(&fonts::lgfxJapanGothicP_16);
  ui->setTextDatum(middle_center);
  ui->setTextColor(rgb(120, 120, 130));
  const int hy = menuY0() + MENU_N * rh - rh / 2 + (big ? 22 : 8);
  if (roundScr) {
    ui->drawString("A: 次の項目   B: 変える", S / 2, hy);
    ui->drawString("A 長押し: とじる", S / 2, hy + 20);
  } else {
    ui->drawString("項目をタップで変える", S / 2, hy);
  }
  present(K_UI);
}
static void openMenu() { mode = M_MENU; menuSel = 0; menuT = millis(); drawMenu(); }
static void closeMenu() {
  if (nFiles <= 0) { showEmpty(); return; }
  if (pos >= 0 && sprFile[ci] != order[pos]) loadPhoto(order[pos], ci);   // 向きを変えたとき: 読みなおす
  infoOn = false; present(K_IMG); mode = M_SHOW; shownAt = millis();
}
// 設定が変わったとき(本体からでもページからでも)
static void applyCfg(bool orderChanged, bool shapeChanged) {
  M5.Display.setBrightness(BRIGHT_VAL[cfgBright]);
  if (orderChanged && nFiles > 0) {
    const int fi = pos >= 0 ? order[pos] : -1;
    shuffleOrder();
    if (cfgOrd == 1 && fi >= 0) { const int p = posOfFile(fi); order[p] = order[0]; order[0] = (uint16_t)fi; }   // 見せている写真を先頭に
    pos = fi >= 0 ? posOfFile(fi) : 0;
    sprFile[1 - ci] = -1;
  }
  (void)shapeChanged;
  saveCfg();
}
static void wifiStart();
// ---- この写真を消す(たしかめる画面)
static constexpr size_t nmOa51 = nmAlignTo(nmOv51, alignof(uint32_t)), nmOv52 = nmOa51 + sizeof(uint32_t); static uint32_t& confirmT = *reinterpret_cast<uint32_t*>(NM_ARENA + nmOa51);
static void openConfirm() {
  if (nFiles <= 0 || pos < 0) return;            // 写真がない
  mode = M_CONFIRM; confirmT = millis();
  const bool big = S >= 400;
  const uint16_t* src = img[ci];
  uint16_t* dst = (uint16_t*)ui->getBuffer();
  for (int i = 0; i < S * S; ++i) dst[i] = mix565(src[i], 0, 22);   // いまの写真を暗くして、うしろに見せる
  const int bw = big ? 320 : 220, bh = big ? 116 : 84;
  ui->fillRect(S / 2 - bw / 2, S / 2 - bh / 2, bw, bh, rgb(24, 16, 22));
  ui->setTextDatum(middle_center);
  ui->setFont(big ? &fonts::lgfxJapanGothicP_24 : &fonts::lgfxJapanGothicP_16);
  ui->setTextColor(TFT_WHITE);
  ui->drawString("この写真を消しますか?", S / 2, S / 2 - (big ? 26 : 20));
  ui->setFont(&fonts::lgfxJapanGothicP_16);
  ui->setTextColor(rgb(170, 170, 178));
  char c[48]; snprintf(c, sizeof(c), "%d / %d 枚目", pos + 1, nFiles);
  ui->drawString(c, S / 2, S / 2 + (big ? 6 : 0));
  ui->setTextColor(rgb(255, 170, 200));
  ui->drawString(roundScr ? "B: 消す      A: やめる" : "右をタップ: 消す   左: やめる", S / 2, S / 2 + (big ? 36 : 24));
  present(K_UI);
}
static const char* apiDel(const char* nm);
static void doDelete() {
  char nm[GNAME_MAX + 1]; strcpy(nm, names[order[pos]]);
  Serial.printf("# delete %s (on device)\n", nm);
  mode = M_SHOW;
  apiDel(nm);                                     // 消して、次の写真を見せる
  if (nFiles <= 0) showEmpty();
}
// ---- USB の送り方
static void openUsbInfo() {
  mode = M_USBINFO; confirmT = millis();
  const bool big = S >= 400;
  ui->fillSprite(TFT_BLACK);
  ui->setTextDatum(middle_center);
  ui->setFont(big ? &fonts::lgfxJapanGothicP_24 : &fonts::lgfxJapanGothicP_20);
  ui->setTextColor(rgb(255, 170, 200));
  const int lh = big ? 27 : 19;
  int y = S / 2 - lh * 5 + (big ? 6 : 8);
  ui->drawString("USB で受け取る", S / 2, y); y += lh + (big ? 10 : 4);
  ui->setFont(&fonts::lgfxJapanGothicP_16);
  static const char* const L[] = {
    "① USB ケーブルで PC につなぐ", "② PC の Chrome か Edge で", "slide.html を開く", "(zip なら docs の中)",
    "③「本体につなぐ」を押す", "④ 写真をページに落とす" };
  for (int i = 0; i < 6; ++i) {
    ui->setTextColor(i == 2 || i == 3 ? rgb(170, 170, 178) : TFT_WHITE);
    ui->drawString(L[i], S / 2, y); y += lh;
  }
  ui->setTextColor(rgb(120, 120, 130));
  ui->drawString("シリアルモニタは閉じておく", S / 2, y); y += lh + (big ? 6 : 2);
  ui->drawString(roundScr ? "A か B: もどる" : "タップ: もどる", S / 2, y);
  present(K_UI);
}
static void menuChange(int i) {
  switch (i) {
    case 0: cfgFx = (cfgFx + 1) % NFX; break;
    case 1: cfgSec = (cfgSec + 1) % NSEC; break;
    case 2: cfgOrd = (cfgOrd + 1) % NORD; break;
    case 3: cfgShape = (cfgShape + 1) % NSHAPE; break;
    case 4: cfgHcol = (cfgHcol + 1) % NHCOL; saveCfg(); drawMenu(); return;
    case 5:                                       // 向き: 読んである写真を読みなおす(とじたときに、新しい向きで見せる)
      cfgFlip = !cfgFlip; sprFile[0] = sprFile[1] = -1; buildMasks(); saveCfg(); drawMenu(); return;
    case 6: cfgBright = (cfgBright + 1) % NBRIGHT; break;
    case 7: openConfirm(); return;
    case 8: wifiStart(); return;
    case 9: openUsbInfo(); return;
    default: closeMenu(); return;
  }
  applyCfg(i == 2, i == 3);
  sendCfg();                                      // ページを開いていれば、そちらの表示も変わる
  drawMenu();
}

// ---------------------------------------------------------------- USB で受け取る
static void replyOK() { char o[64]; fsStats(); snprintf(o, sizeof(o), "NMS OK %u %u", (unsigned)fsTotal, (unsigned)fsUsed); reply(o); }
static void backToShow() {                         // 受け取りなどが終わったら、写真に戻る
  if (nFiles <= 0) { showEmpty(); return; }
  if (pos < 0) pos = 0;
  showNow(pos);
}
static void rxAbort(const char* why) {
  if (rxFile) { rxFile->close(); delete rxFile; rxFile = nullptr; }
  if (fsOk) FFat.remove("/slide/~up.tmp");
  rxActive = rxWaitDone = false;
  char o[48]; snprintf(o, sizeof(o), "NMS ERR %s", why); reply(o);
  backToShow();
}
static void drawProgress(const char* name, uint32_t got, uint32_t size) {
  const int pct = size ? (int)((uint64_t)got * 100 / size) : 100;
  ui->fillSprite(TFT_BLACK);
  ui->setFont(&fonts::lgfxJapanGothicP_20);
  ui->setTextDatum(middle_center);
  ui->setTextColor(TFT_WHITE);
  char s[64]; snprintf(s, sizeof(s), "受け取り中  %d%%", pct);
  ui->drawString(s, S / 2, S / 2 - 22);
  ui->setTextColor(rgb(170, 170, 178));
  ui->drawString(name, S / 2, S / 2 + 6);
  const int bw = min(240, S - 60);
  ui->fillRect(S / 2 - bw / 2, S / 2 + 30, bw, 6, rgb(64, 64, 64));
  ui->fillRect(S / 2 - bw / 2, S / 2 + 30, bw * pct / 100, 6, rgb(255, 150, 190));
  present(K_UI);
}
static void showProgress(bool force) {
  const int pct = rxSize ? (int)((uint64_t)rxGot * 100 / rxSize) : 100;
  if (!force && (pct == rxShownPct || millis() - rxShownMs < 120)) return;
  rxShownPct = pct; rxShownMs = millis();
  drawProgress(rxName, rxGot, rxSize);
}

// 設定を変える(USB の SET / ページの /api/set)。だめなら "ARG"
static const char* apiSet(int a, int b, int c, int d, int e) {
  if (a < 0 || a >= NFX || b < 0 || b >= NSEC || c < 0 || c >= NORD || d < 0 || d >= NSHAPE || e < 0 || e >= NBRIGHT) return "ARG";
  const bool oc = c != cfgOrd, sc = d != cfgShape;
  cfgFx = a; cfgSec = b; cfgOrd = c; cfgShape = d; cfgBright = e;
  applyCfg(oc, sc);
  sendCfg();
  if (mode == M_MENU) drawMenu();
  else if (mode == M_SHOW && sc) present(K_IMG);    // 形が変わった → すぐ描き直す
  return nullptr;
}
// 写真を1枚消す
static const char* apiDel(const char* nm) {
  const int idx = findFile(nm);
  if (idx < 0) return "NOFILE";
  char keep[GNAME_MAX + 1] = {0};
  const bool wasShowing = pos >= 0 && order[pos] == idx;
  if (pos >= 0 && !wasShowing) strcpy(keep, names[order[pos]]);
  char path[64]; snprintf(path, sizeof(path), "/slide/%s", nm);
  FFat.remove(path);
  const int oldPos = pos;
  scanFiles();
  filesChanged(keep);
  if (wasShowing) pos = nFiles ? min(oldPos, nFiles - 1) : -1;
  if (mode == M_MENU) return nullptr;
  if (mode == M_WIFI) { wifiDirty = true; return nullptr; }
  if (wasShowing || mode == M_EMPTY || mode == M_TRANS) showNow(pos);
  return nullptr;
}
static void apiClear() {
  for (int i = 0; i < nFiles; ++i) { char path[64]; snprintf(path, sizeof(path), "/slide/%s", names[i]); FFat.remove(path); }
  scanFiles();
  filesChanged(nullptr);
  if (mode == M_WIFI) { wifiDirty = true; return; }
  if (mode != M_MENU) showEmpty();
}
static const char* apiShow(const char* nm) {
  const int idx = findFile(nm);
  if (idx < 0) return "NOFILE";
  if (mode == M_MENU) mode = M_SHOW;
  showNow(posOfFile(idx));
  return nullptr;
}

static void handleLine(char* s) {
  if (strncmp(s, "NMS ", 4)) return;
  char* cmd = s + 4;
  if (!strcmp(cmd, "HELLO")) {
    fsStats();
    char o[96]; snprintf(o, sizeof(o), "NMS HELLO 1 %u %u %d %d %d %d %d", (unsigned)fsTotal, (unsigned)fsUsed, nFiles, fsOk ? 1 : 0, S, nextSeq, roundScr ? 1 : 0); reply(o);
    sendCfg();
  } else if (!strcmp(cmd, "LIST")) {
    char o[96];
    for (int i = 0; i < nFiles; ++i) { snprintf(o, sizeof(o), "NMS FILE %u %s", (unsigned)sizes[i], names[i]); reply(o); }
    snprintf(o, sizeof(o), "NMS END %d", nFiles); reply(o);
  } else if (!strcmp(cmd, "CFG")) {
    sendCfg();
  } else if (!strncmp(cmd, "SET ", 4)) {
    int a, b, c, d, e;
    if (sscanf(cmd + 4, "%d %d %d %d %d", &a, &b, &c, &d, &e) != 5 || apiSet(a, b, c, d, e)) { reply("NMS ERR ARG"); return; }
  } else if (!strncmp(cmd, "PUT ", 4)) {
    unsigned sz = 0; char nm[64] = {0};
    if (sscanf(cmd + 4, "%u %63s", &sz, nm) != 2 || !goodName(nm)) { reply("NMS ERR NAME"); return; }
    if (!fsOk) { reply("NMS ERR NOFS"); return; }
    if (upFile) { reply("NMS ERR BUSY"); return; }   // Wi-Fi で受け取っている最中
    fsStats();
    const int idx = findFile(nm);
    const size_t freeNow = (fsTotal > fsUsed ? fsTotal - fsUsed : 0) + (idx >= 0 ? sizes[idx] : 0);
    if (sz == 0 || sz > (unsigned)MAX_JPG) { reply("NMS ERR BIG"); return; }
    if ((size_t)sz + 32768 > freeNow) { reply("NMS ERR FULL"); return; }
    if (idx < 0 && nFiles >= MAX_FILES) { reply("NMS ERR MANY"); return; }
    FFat.remove("/slide/~up.tmp");
    File f = FFat.open("/slide/~up.tmp", "w");
    if (!f) { reply("NMS ERR OPEN"); return; }
    rxFile = new File(f);
    strcpy(rxName, nm); rxSize = sz; rxGot = 0; rxSinceAck = 0; rxCrc = 0; rxLast = millis();
    rxActive = true; rxWaitDone = false; rxShownPct = -1;
    if (mode == M_TRANS) { ci = 1 - ci; pos = trTo; }
    showProgress(true);
    char o[32]; snprintf(o, sizeof(o), "NMS READY %d", CHUNK); reply(o);
  } else if (!strncmp(cmd, "DONE ", 5)) {
    if (!rxWaitDone) { reply("NMS ERR STATE"); return; }
    const uint32_t want = (uint32_t)strtoul(cmd + 5, nullptr, 16);
    rxFile->close(); delete rxFile; rxFile = nullptr;
    rxActive = rxWaitDone = false;
    if (want != rxCrc) { FFat.remove("/slide/~up.tmp"); reply("NMS ERR CRC"); backToShow(); return; }
    char path[64]; snprintf(path, sizeof(path), "/slide/%s", rxName);
    FFat.remove(path);
    if (!FFat.rename("/slide/~up.tmp", path)) { FFat.remove("/slide/~up.tmp"); reply("NMS ERR SAVE"); backToShow(); return; }
    scanFiles();
    filesChanged(rxName);                          // 受け取った写真を見せる
    replyOK();
    showNow(pos);
  } else if (!strncmp(cmd, "DEL ", 4)) {
    if (apiDel(cmd + 4)) { reply("NMS ERR NOFILE"); return; }
    replyOK();
  } else if (!strcmp(cmd, "CLEAR")) {               // 全部消す
    apiClear();
    replyOK();
  } else if (!strncmp(cmd, "SHOW ", 5)) {
    if (apiShow(cmd + 5)) { reply("NMS ERR NOFILE"); return; }
    replyOK();
  } else {
    reply("NMS ERR CMD");
  }
}

static void pollUsb() {
  for (int guard = 0; guard < 64; ++guard) {
    int av = Serial.available();
    if (av <= 0) break;
    if (rxActive && !rxWaitDone) {                 // データを受け取っている最中
      const uint32_t want = min((uint32_t)min(av, CHUNK), rxSize - rxGot);
      const int n = (int)Serial.read(rxBuf, want);
      if (n <= 0) break;
      rxFile->write(rxBuf, n);
      rxCrc = crcAdd(rxCrc, rxBuf, n);
      rxGot += n; rxSinceAck += n; rxLast = millis();
      if (rxSinceAck >= (uint32_t)CHUNK || rxGot >= rxSize) {
        rxSinceAck = 0;
        char o[32]; snprintf(o, sizeof(o), "NMS ACK %u", (unsigned)rxGot); reply(o);
      }
      if (rxGot >= rxSize) rxWaitDone = true;
      showProgress(rxGot >= rxSize);
      continue;
    }
    const int c = Serial.read();
    if (c < 0) break;
    if (c == '\r') continue;
    if (c == '\n') { line[lineLen] = 0; handleLine(line); lineLen = 0; continue; }
    if (lineLen < (int)sizeof(line) - 1) line[lineLen++] = (char)c;
  }
  if (rxActive && millis() - rxLast > 8000) rxAbort("TIMEOUT");
}

// ---------------------------------------------------------------- Wi-Fi で受け取る
// 本体が Wi-Fi(アクセスポイント)を出して、スマホや PC のブラウザに http://192.168.4.1 のページを出す。
// 名前とパスワードは本体ごとに決まっていて(毎回同じ)、画面の QR コードを読めば入れる。
// ==== PAGE BEGIN ====
// ページ(slide_wifi.html を gzip したもの。tools/wifi-pages/genpage.py で作り直せます)
static const uint8_t PAGE_GZ[4854] = {
  0x1f,0x8b,0x08,0x00,0x00,0x00,0x00,0x00,0x02,0x03,0xa5,0x3a,0x6b,0x77,0xdb,0xc6,0x95,0xdf,0xf5,0x2b,
  0xc6,0xb4,0x53,0x80,0x31,0x09,0x3e,0xf4,0x34,0x28,0x29,0x6b,0x75,0xed,0xda,0x59,0xbf,0xd6,0xb2,0x77,
  0xd3,0xd5,0x2a,0x36,0x08,0x0e,0xc9,0x91,0x40,0x00,0x01,0x86,0x96,0x14,0x57,0x7b,0x4c,0x2a,0x4d,0xec,
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  0x05,0xf9,0x47,0xf9,0xff,0x07,0xb9,0xfc,0x45,0xf1,0xa5,0x2f,0x00,0x00,
};
// ==== PAGE END ====

static void wifiIds() {
#if NL_WIFI
  const uint64_t mac = ESP.getEfuseMac();
#else
  const uint64_t mac = 0x0000A1B2C3D4E5F6ull;
#endif
  snprintf(wifiSsid, sizeof(wifiSsid), "Null2-%04X", (unsigned)((mac >> 32) & 0xFFFF));
  uint32_t h = (uint32_t)(mac ^ (mac >> 21) ^ (mac >> 40)) * 2654435761u;
  h ^= h >> 15; h *= 2246822519u; h ^= h >> 13;
  snprintf(wifiPass, sizeof(wifiPass), "%08u", (unsigned)(h % 100000000u));
}

// Wi-Fi の画面: QR コード・名前・パスワード・アドレス・残りの時間
static void wifiDraw() {
  const bool big = S >= 400;
  ui->fillSprite(TFT_BLACK);
  ui->setTextDatum(middle_center);
  ui->setFont(big ? &fonts::lgfxJapanGothicP_24 : &fonts::lgfxJapanGothicP_16);
  ui->setTextColor(rgb(255, 170, 200));
  ui->drawString("Wi-Fi で受け取る", S / 2, big ? 66 : 10);
#if NL_WIFI
  if (!wifiOn) {
    ui->setFont(&fonts::lgfxJapanGothicP_20);
    ui->setTextColor(TFT_WHITE);
    ui->drawString("Wi-Fi を始められませんでした", S / 2, S / 2);
    present(K_UI);
    return;
  }
  char q[96];
  if (wifiQr == 0) snprintf(q, sizeof(q), "WIFI:T:WPA;S:%s;P:%s;;", wifiSsid, wifiPass);
  else             snprintf(q, sizeof(q), "http://192.168.4.1/");
  const int qs = big ? 172 : 92, qy = big ? 88 : 26;
  ui->fillRect(S / 2 - qs / 2 - 6, qy - 6, qs + 12, qs + 12, TFT_WHITE);   // まわりに白い余白(読み取りやすく)
  ui->qrcode(q, S / 2 - qs / 2, qy, qs);
  int y = qy + qs + (big ? 22 : 14);
  const int lh = big ? 26 : 17;
  ui->setFont(big ? &fonts::lgfxJapanGothicP_20 : &fonts::lgfxJapanGothicP_16);
  ui->setTextColor(TFT_WHITE);
  ui->drawString(wifiQr == 0 ? "① カメラで読んで Wi-Fi に入る" : "② カメラで読んでページを開く", S / 2, y); y += lh + 4;
  ui->setTextColor(rgb(200, 200, 210));
  char line[64];
  if (wifiQr == 0) {
    snprintf(line, sizeof(line), "Wi-Fi  %s", wifiSsid);  ui->drawString(line, S / 2, y); y += lh;
    snprintf(line, sizeof(line), "パスワード  %s", wifiPass); ui->drawString(line, S / 2, y); y += lh;
  } else {
    ui->drawString("http://192.168.4.1", S / 2, y); y += lh;
    snprintf(line, sizeof(line), "つながっている  %d 台", wifiSta < 0 ? 0 : wifiSta); ui->drawString(line, S / 2, y); y += lh;
  }
  ui->setFont(&fonts::lgfxJapanGothicP_16);
  if (wifiMsg[0]) { ui->setTextColor(rgb(255, 170, 200)); ui->drawString(wifiMsg, S / 2, y); }
  y += big ? 22 : 16;
  ui->setTextColor(rgb(120, 120, 130));
  snprintf(line, sizeof(line), "あと%d分で自動で切れます", wifiShownMin < 1 ? 1 : wifiShownMin);
  ui->drawString(line, S / 2, y); y += 18;
  ui->drawString(roundScr ? "A: QR を切り替え   B: おわる" : "タップ: QR切替  電源: おわる", S / 2, y);
#else
  ui->setFont(&fonts::lgfxJapanGothicP_20);
  ui->setTextColor(TFT_WHITE);
  ui->drawString("ここでは Wi-Fi は使えません", S / 2, S / 2 - 14);
  ui->setTextColor(rgb(170, 170, 178));
  ui->drawString("(本物の本体で使えます)", S / 2, S / 2 + 14);
#endif
  present(K_UI);
}

#if NL_WIFI
static void webJson(int code, const char* body) {
  web->sendHeader("Cache-Control", "no-store");
  web->send(code, "application/json", body);
}
static void webErr(const char* e) { char o[48]; snprintf(o, sizeof(o), "{\"err\":\"%s\"}", e); webJson(e[0] == 'N' && e[1] == 'O' && e[2] == 'F' && e[3] == 'I' ? 404 : 400, o); }
static void webInfo() {
  fsStats();
  char o[200];
  snprintf(o, sizeof(o), "{\"app\":\"slide\",\"total\":%u,\"used\":%u,\"count\":%d,\"size\":%d,\"round\":%s,\"seq\":%d,\"cfg\":[%d,%d,%d,%d,%d]}",
           (unsigned)fsTotal, (unsigned)fsUsed, nFiles, S, roundScr ? "true" : "false", nextSeq, cfgFx, cfgSec, cfgOrd, cfgShape, cfgBright);
  webJson(200, o);
}
static void webTouch() { wifiLast = millis(); }
static void webList() {
  webTouch();
  web->sendHeader("Cache-Control", "no-store");
  web->setContentLength(CONTENT_LENGTH_UNKNOWN);
  web->send(200, "application/json", "");
  char buf[1024]; int n = snprintf(buf, sizeof(buf), "{\"files\":[");
  for (int i = 0; i < nFiles; ++i) {
    if (n > (int)sizeof(buf) - 80) { web->sendContent(buf, n); n = 0; }
    n += snprintf(buf + n, sizeof(buf) - n, "%s{\"n\":\"%s\",\"s\":%u}", i ? "," : "", names[i], (unsigned)sizes[i]);
  }
  n += snprintf(buf + n, sizeof(buf) - n, "]}");
  web->sendContent(buf, n);
  web->sendContent("");
}
// 写真の受け取り(本文がそのまま写真。名前は X-Name の見出しで)
static void upClose(bool keep) {
  if (upFile) { upFile->close(); delete upFile; upFile = nullptr; }
  if (!keep && fsOk) FFat.remove("/slide/~web.tmp");
}
static void webUpload() {
  HTTPRaw& r = web->raw();
  if (r.status == RAW_START) {
    webTouch();
    upErr = nullptr; upGot = 0; upShownMs = 0;
    upSize = (uint32_t)web->clientContentLength();
    String nm = web->header("X-Name");
    strncpy(upName, nm.c_str(), GNAME_MAX); upName[GNAME_MAX] = 0;
    if (rxActive) upErr = "BUSY";
    else if (!goodName(nm.c_str()) || nm.length() > GNAME_MAX) upErr = "NAME";
    else if (!fsOk) upErr = "NOFS";
    else if (upSize == 0 || upSize > (uint32_t)MAX_JPG) upErr = "BIG";
    else {
      fsStats();
      const int idx = findFile(upName);
      const size_t freeNow = (fsTotal > fsUsed ? fsTotal - fsUsed : 0) + (idx >= 0 ? sizes[idx] : 0);
      if ((size_t)upSize + 32768 > freeNow) upErr = "FULL";
      else if (idx < 0 && nFiles >= MAX_FILES) upErr = "MANY";
    }
    if (!upErr) {
      FFat.remove("/slide/~web.tmp");
      File f = FFat.open("/slide/~web.tmp", "w");
      if (!f) upErr = "OPEN"; else upFile = new File(f);
    }
    if (!upErr) drawProgress(upName, 0, upSize);
  } else if (r.status == RAW_WRITE) {
    if (upFile && !upErr && r.currentSize) {
      if (upFile->write(r.buf, r.currentSize) != r.currentSize) upErr = "SAVE";
      upGot += r.currentSize;
      if (millis() - upShownMs > 250) { upShownMs = millis(); drawProgress(upName, upGot, upSize); }
    }
  } else if (r.status == RAW_END) {
    webTouch();
    if (upErr || !upFile) { upClose(false); if (!upErr) upErr = "OPEN"; return; }
    upClose(true);
    if (upGot != upSize) { upErr = "SAVE"; FFat.remove("/slide/~web.tmp"); return; }
    char path[64]; snprintf(path, sizeof(path), "/slide/%s", upName);
    FFat.remove(path);
    if (!FFat.rename("/slide/~web.tmp", path)) { FFat.remove("/slide/~web.tmp"); upErr = "SAVE"; return; }
    char keep[GNAME_MAX + 1] = {0};
    if (pos >= 0 && pos < nFiles) strcpy(keep, names[order[pos]]);
    scanFiles();
    filesChanged(keep[0] ? keep : upName);
    snprintf(wifiMsg, sizeof(wifiMsg), "受け取りました(写真 %d 枚)", nFiles);
    Serial.printf("# wifi got %s  %u bytes\n", upName, (unsigned)upGot);
  } else {                                        // とちゅうで切れた
    upClose(false);
    upErr = "ABORT";
  }
}
static void webUploadDone() {
  wifiDirty = true;
  if (upErr) webErr(upErr); else webInfo();
  upErr = nullptr;
}
static void webFile() {                           // /f/名前 … 写真そのもの(ページの一覧の絵)
  const String u = web->uri();
  if (strncmp(u.c_str(), "/f/", 3) || !goodName(u.c_str() + 3)) { webErr("NOFILE"); return; }
  char path[64]; snprintf(path, sizeof(path), "/slide/%s", u.c_str() + 3);
  File f = FFat.open(path, "r");
  if (!f) { webErr("NOFILE"); return; }
  web->sendHeader("Cache-Control", "max-age=86400");
  web->streamFile(f, "image/jpeg");
  f.close();
}
#endif

static void wifiStop();
// Wi-Fi を始める(設定の「Wi-Fi で受け取る」)
static void wifiStart() {
  mode = M_WIFI;
  wifiQr = 0; wifiSta = -1; wifiMsg[0] = 0; wifiPeekUntil = 0; wifiShownMin = -1;
  wifiLast = millis();
  wifiIds();
#if NL_WIFI
  {
    const char* L[] = {"Wi-Fi を始めています…"};
    uiMessage(L, 1);
  }
  WiFi.mode(WIFI_AP);
  if (!WiFi.softAP(wifiSsid, wifiPass, 6, 0, 3)) {
    Serial.println("# wifi: softAP failed");
    WiFi.mode(WIFI_OFF);
    wifiOn = false; wifiDirty = true;
    return;
  }
  WiFi.setTxPower(WIFI_POWER_11dBm);              // すぐ近くで使うので、電波は弱めに(電池のため)
  web = new WebServer(80);
  static const char* hk[] = {"X-Name"};
  web->collectHeaders(hk, 1);
  web->on("/", HTTP_GET, []() {
    webTouch();
    web->sendHeader("Content-Encoding", "gzip");
    web->sendHeader("Cache-Control", "no-store");
    web->send_P(200, "text/html", (const char*)PAGE_GZ, sizeof(PAGE_GZ));
  });
  web->on("/api/info", HTTP_GET, []() { webTouch(); webInfo(); });
  web->on("/api/list", HTTP_GET, []() { webList(); });
  web->on("/api/up", HTTP_POST, []() { webUploadDone(); }, []() { webUpload(); });
  web->on("/api/del", HTTP_GET, []() {
    webTouch();
    const char* e = apiDel(web->arg("n").c_str());
    if (e) webErr(e); else webInfo();
  });
  web->on("/api/show", HTTP_GET, []() {
    webTouch();
    const char* e = apiShow(web->arg("n").c_str());
    if (e) webErr(e); else webInfo();
  });
  web->on("/api/clear", HTTP_GET, []() { webTouch(); apiClear(); webInfo(); });
  web->on("/api/set", HTTP_GET, []() {
    webTouch();
    int a = -1, b = -1, c = -1, d = -1, e = -1;
    if (sscanf(web->arg("c").c_str(), "%d,%d,%d,%d,%d", &a, &b, &c, &d, &e) != 5 || apiSet(a, b, c, d, e)) { webErr("ARG"); return; }
    webInfo();
  });
  web->onNotFound([]() { webFile(); });
  web->begin();
  wifiOn = true;
  Serial.printf("# wifi on  %s  pass %s  http://192.168.4.1\n", wifiSsid, wifiPass);
#endif
  wifiDirty = true;
}
// Wi-Fi を切って、写真に戻る
static void wifiStop() {
#if NL_WIFI
  if (web) { web->stop(); delete web; web = nullptr; }
  upClose(false);
  if (wifiOn) { WiFi.softAPdisconnect(true); WiFi.mode(WIFI_OFF); Serial.println("# wifi off"); }
#endif
  wifiOn = false; wifiPeekUntil = 0;
  mode = M_SHOW;
  if (nFiles <= 0) { showEmpty(); return; }
  showNow(pos < 0 ? 0 : pos);
}
// Wi-Fi の画面のあいだの loop
static void wifiLoop(bool tapped) {
#if NL_WIFI
  if (web) web->handleClient();
  if (wifiOn) {
    const int sta = WiFi.softAPgetStationNum();
    if (sta != wifiSta) {
      if (sta > 0 && wifiSta <= 0) wifiQr = 1;    // スマホが入ってきた → ページの QR へ
      wifiSta = sta; wifiDirty = true; wifiLast = millis();
    }
  }
#endif
  if (mode != M_WIFI) return;
  const uint32_t idle = millis() - wifiLast;
  if (idle >= WIFI_IDLE_MS) { wifiStop(); return; }  // しばらく何もなかった → 自動で切る
  const int left = (int)((WIFI_IDLE_MS - idle + 59999) / 60000);
  if (left != wifiShownMin) { wifiShownMin = left; wifiDirty = true; }
  bool flip = false, quit = false;
  if (roundScr) { flip = M5.BtnA.wasClicked(); quit = M5.BtnB.wasClicked(); }
  else          { flip = tapped; quit = M5.BtnPWR.wasClicked(); }
  if (quit) { wifiStop(); return; }
  if (flip) { wifiQr ^= 1; wifiLast = millis(); wifiPeekUntil = 0; wifiDirty = true; }
  if (wifiPeekUntil && (int32_t)(millis() - wifiPeekUntil) >= 0) { wifiPeekUntil = 0; wifiDirty = true; }
  if (wifiDirty && !wifiPeekUntil) { wifiDirty = false; wifiDraw(); }
  delay(2);
}

// ---------------------------------------------------------------- setup / loop
static void fail(const char* msg) {
  M5.Display.setTextDatum(middle_center);
  M5.Display.drawString(msg, M5.Display.width() / 2, M5.Display.height() / 2);
  Serial.println(msg);
  while (true) nmIdle();
}
static uint16_t* allocImg() {
  M5Canvas* c = new M5Canvas(&M5.Display);
  c->setColorDepth(16);
  c->setPsram(true);
  if (!c->createSprite(S, S)) return nullptr;
  if (!spr[0]) spr[0] = c; else if (!spr[1]) spr[1] = c; else ui = c;
  return (uint16_t*)c->getBuffer();
}

void setup() {
  auto cfg = M5.config();
  M5.begin(cfg);
  Serial.setRxBufferSize(8192);                   // USB で写真を受け取るので、受け口を大きく
  Serial.begin(115200);
  Serial.println("NullSlide v7");

  if (M5.Display.width() < M5.Display.height()) M5.Display.setRotation(1);
  W = M5.Display.width(); H = M5.Display.height();
  roundScr = (W == H);
  S = min(W, H) & ~1;                             // 写真は短いほうの辺に合わせた正方形(四角い画面は左右が黒)
  XOFF = ((W - S) / 2) & ~1; YOFF = (H - S) / 2;
  NB = (S + BAND - 1) / BAND;
  M5.Display.fillScreen(TFT_BLACK);
  { auto* pnl = M5.Display.getPanel(); fbMode = pnl && pnl->getAutoDisplay();
#if defined(NL_DIRECT_AMOLED)
    if (fbMode && DIRECT_SEND && M5.getBoard() == m5::board_t::board_M5StopWatch) {
      lgfx::Panel_AMOLED* inner = NlFbPeek::inner(pnl);
      if (inner) { M5.Display.setPanel(inner); fbMode = false; directSend = true; }   // ここからは本物の画面へ直接
    }
#endif
  }
  Serial.printf("display: %s\n", fbMode ? "framebuffer" : directSend ? "direct DMA (StopWatch, no framebuffer)" : "direct DMA");

  names  = (char(*)[GNAME_MAX + 1])ps_malloc((size_t)MAX_FILES * (GNAME_MAX + 1));
  sizes  = (uint32_t*)ps_malloc(MAX_FILES * sizeof(uint32_t));
  order  = (uint16_t*)ps_malloc(MAX_FILES * sizeof(uint16_t));
  jpgBuf = (uint8_t*)ps_malloc(MAX_JPG);
  rxBuf  = (uint8_t*)malloc(CHUNK);
  band[0] = (uint16_t*)heap_caps_malloc((size_t)S * BAND * 2, MALLOC_CAP_DMA);
  band[1] = (uint16_t*)heap_caps_malloc((size_t)S * BAND * 2, MALLOC_CAP_DMA);
  for (int m = 0; m < 2; ++m) {
    for (int k = 0; k < 4; ++k) mk[m][k] = (int16_t*)malloc(S * 2);
    mkBx[m] = (int16_t*)malloc(NB * 2); mkBw[m] = (int16_t*)malloc(NB * 2);
  }
  img[0] = allocImg(); img[1] = allocImg();
  hTab = (float*)ps_malloc(HN * 4 * sizeof(float));
  uint16_t* u = allocImg(); (void)u;
  cap = new M5Canvas(&M5.Display);
  cap->setColorDepth(16);
  if (!cap->createSprite(CAPW, CAPH)) cap = nullptr;
  if (!names || !sizes || !order || !jpgBuf || !rxBuf || !band[0] || !band[1] || !img[0] || !img[1] || !ui || !cap ||
      !mk[0][3] || !mk[1][3] || !mkBw[1] || !hTab) fail("Memory error");
  capX = (S / 2 - CAPW / 2) & ~1;
  capY = roundScr ? S - 96 : S - 44;
  buildMasks();
  buildHeartTab();

  {
    const char* L[] = {"写真の置き場を準備しています", "(初めてのときは少し時間がかかります)"};
    uiMessage(L, 2);
  }
  fsOk = FFat.begin(true);
  if (fsOk && !FFat.exists("/slide")) FFat.mkdir("/slide");
  if (fsOk) FFat.remove("/slide/~up.tmp");
  loadCfg();
  buildMasks();                                   // 向き(さかさま)を読んだので、ハートの窓を作りなおす
  M5.Display.setBrightness(BRIGHT_VAL[cfgBright]);
  scanFiles();
  filesChanged(nullptr);
  Serial.printf("# slide: %s  %d photos  used %u / %u bytes  next %d\n", fsOk ? "ok" : "NO FATFS", nFiles, (unsigned)fsUsed, (unsigned)fsTotal, nextSeq);
  if (nFiles) showNow(0); else showEmpty();
}

void loop() {
  static uint32_t lastTapMs = 0;
  M5.update();
  pollUsb();
  if (rxActive) { delay(1); return; }             // 受け取っているあいだは、ほかのことは休む

  auto t = M5.Touch.getDetail();
  if (mode == M_WIFI) { wifiLoop(t.wasPressed() && !(t.x < 56 && t.y < 56)); return; }
  // ---- 消すかどうか / USB の説明
  if (mode == M_CONFIRM || mode == M_USBINFO) {
    int act = 0;                                   // 1 = 消す / -1 = もどる
    if (roundScr) {
      if (mode == M_CONFIRM && M5.BtnB.wasClicked()) act = 1;
      else if (M5.BtnA.wasClicked() || M5.BtnA.wasHold() || M5.BtnB.wasClicked()) act = -1;
    } else {
      if (M5.BtnPWR.wasClicked()) act = -1;
      if (t.wasPressed() && millis() - lastTapMs > 200 && !(t.x < 56 && t.y < 56)) {
        lastTapMs = millis();
        act = (mode == M_CONFIRM && t.x >= W / 2) ? 1 : -1;
      }
    }
    if (!act && millis() - confirmT > (uint32_t)MENU_IDLE_MS * 2) act = -1;
    if (act == 1) { doDelete(); return; }
    if (act == -1) { mode = M_MENU; menuT = millis(); drawMenu(); return; }
    delay(5);
    return;
  }
  // ---- 設定の画面
  if (mode == M_MENU) {
    if (roundScr) {
      if (M5.BtnA.wasHold())         { closeMenu(); return; }
      if (M5.BtnA.wasClicked())      { menuSel = (menuSel + 1) % MENU_N; menuT = millis(); drawMenu(); }
      if (M5.BtnB.wasClicked())      { menuT = millis(); menuChange(menuSel); return; }
    } else {
      if (M5.BtnPWR.wasClicked())    { closeMenu(); return; }
      if (t.wasPressed() && millis() - lastTapMs > 200 && !(t.x < 56 && t.y < 56)) {
        lastTapMs = millis(); menuT = millis();
        const int rh = menuRowH(), yy = t.y - YOFF;
        const int i = (int)floorf((yy - (menuY0() - rh / 2)) / (float)rh);
        if (i >= 0 && i < MENU_N) { menuSel = i; menuChange(i); return; }
      }
    }
    if (millis() - menuT > (uint32_t)MENU_IDLE_MS) closeMenu();
    delay(5);
    return;
  }

  // ---- ボタン
  int go = 0;
  if (roundScr) {
    if (M5.BtnA.wasHold())         go = -1;
    else if (M5.BtnA.wasClicked()) go = 1;
    if (M5.BtnB.wasClicked() && fsOk) { if (mode == M_TRANS) { ci = 1 - ci; pos = trTo; } openMenu(); return; }
  } else {
    if (M5.BtnPWR.wasClicked() && fsOk) { if (mode == M_TRANS) { ci = 1 - ci; pos = trTo; } openMenu(); return; }
    if (t.wasPressed() && millis() - lastTapMs > 250 && !(t.x < 56 && t.y < 56)) {
      lastTapMs = millis();
      go = t.x < W / 2 ? -1 : 1;
    }
  }

  if (mode == M_EMPTY) { delay(10); return; }
  if (mode == M_TRANS) {
    if (go) { ci = 1 - ci; pos = trTo; mode = M_SHOW; goTo(pos + go, go, true); return; }   // 切り替え中に押した: すぐ次へ
    stepTrans();
    return;
  }
  // M_SHOW
  if (go) { goTo(pos + go, go, true); return; }
  if (infoOn && (int32_t)(millis() - infoUntil) >= 0) { infoOn = false; present(K_IMG); }
  const uint32_t sec = SEC_VAL[cfgSec];
  if (sec && nFiles > 1 && millis() - shownAt >= sec * 1000u) { goTo(pos + 1, 1, false); return; }
  // ひまなときに、次の写真を読んでおく
  if (nFiles > 1 && millis() - shownAt > 150) {
    const int np = wrapPos(pos + 1);
    if (!(cfgOrd == 1 && np == 0)) loadPhoto(order[np], 1 - ci);   // ランダムで一回りするときは、混ぜ直してから読む
  }
  delay(5);
}


// 共通の置き場に置いたものは、0 で始まる単純な型だけ(コンストラクタが要らないもの)
static_assert(std::is_trivially_default_constructible<bool>::value, "NM_ARENA: bool");
static_assert(std::is_trivially_default_constructible<char>::value, "NM_ARENA: char");
static_assert(std::is_trivially_default_constructible<int>::value, "NM_ARENA: int");
static_assert(std::is_trivially_default_constructible<size_t>::value, "NM_ARENA: size_t");
static_assert(std::is_trivially_default_constructible<uint16_t>::value, "NM_ARENA: uint16_t");
static_assert(std::is_trivially_default_constructible<uint32_t>::value, "NM_ARENA: uint32_t");
static constexpr size_t OVL_END = nmAlignTo(nmOv52, 16);
static_assert(OVL_END <= NM_ARENA_SIZE, "NM_ARENA_SIZE (nm_common.h) を大きくしてください");
extern const size_t OVL_SIZE = OVL_END;   // 起動時の確認用
}  // namespace NullSlide
